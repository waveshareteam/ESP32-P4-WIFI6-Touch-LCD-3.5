## example/ESP-IDF/11_esp_brookesia_phone/sdkconfig.defaults
```kconfig
CONFIG_ESPTOOLPY_FLASHSIZE_16MB=y
CONFIG_ESPTOOLPY_FLASHSIZE="16MB"
CONFIG_PARTITION_TABLE_CUSTOM=y
CONFIG_PARTITION_TABLE_CUSTOM_FILENAME="partitions.csv"

CONFIG_ESP_TASK_WDT_EN=y
CONFIG_ESP_TASK_WDT_INIT=y
CONFIG_ESP_TASK_WDT_PANIC=n
CONFIG_ESP_TASK_WDT_TIMEOUT_S=20
CONFIG_ESP_TASK_WDT_CHECK_IDLE_TASK_CPU0=y
CONFIG_ESP_TASK_WDT_CHECK_IDLE_TASK_CPU1=y

CONFIG_SPIRAM=y
CONFIG_SPIRAM_SPEED_200M=y
CONFIG_SPIRAM_XIP_FROM_PSRAM=y
CONFIG_CACHE_L2_CACHE_256KB=y
CONFIG_CACHE_L2_CACHE_LINE_128B=y

CONFIG_ESP_BROOKESIA_ENABLE_AI_FRAMEWORK=n
CONFIG_ESP_BROOKESIA_AI_FRAMEWORK_ENABLE_AGENT=n
CONFIG_ESP_BROOKESIA_AI_FRAMEWORK_ENABLE_EXPRESSION=n

CONFIG_ESP_BROOKESIA_SYSTEMS_ENABLE_PHONE=y
CONFIG_ESP_BROOKESIA_SYSTEMS_ENABLE_SPEAKER=n

CONFIG_LV_FONT_MONTSERRAT_18=y
CONFIG_LV_FONT_MONTSERRAT_20=y
CONFIG_LV_FONT_MONTSERRAT_22=y

CONFIG_LV_ATTRIBUTE_MEM_ALIGN_SIZE=64
CONFIG_LV_DRAW_BUF_ALIGN=64
# CONFIG_LV_USE_PPA is not set
CONFIG_LV_DRAW_SW_SHADOW_CACHE_SIZE=336
CONFIG_LV_DRAW_SW_DRAW_UNIT_CNT=1
```
